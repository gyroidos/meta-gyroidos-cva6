## conf/layer.conf
```bitbake
BBPATH := "${BBPATH}:${LAYERDIR}" 

BBFILES := "${BBFILES} ${LAYERDIR}/recipes-*/*/*.bb \ 
           ${LAYERDIR}/recipes-*/*/*.bbappend \
	   ${LAYERDIR}/images/*.bb*"


BBFILE_COLLECTIONS += "gyroidos-cva6"
BBFILE_PATTERN_gyroidos-cva6 := "^${LAYERDIR}/"
BBFILE_PRIORITY_gyroidos-cva6 := "7"

LAYERDEPENDS_gyroidos-cva6 = "gyroidos-layer meta-cva6"

LAYERSERIES_COMPAT_gyroidos-cva6 += "scarthgap"
```
